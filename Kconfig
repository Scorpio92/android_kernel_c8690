## Kconfig
```kconfig
#
# For a description of the syntax of this configuration file,
# see Documentation/kbuild/kconfig-language.txt.
#
mainmenu "Linux/$ARCH $KERNELVERSION Kernel Configuration"

config SRCARCH
	string
	option env="SRCARCH"

config CC_OPTIMIZE_MORE
	bool "CC_OPTIMIZE_MORE"
	depends on TC4_ICS=y
	default y

source "arch/$SRCARCH/Kconfig"
```

## drivers/media/video/exynos-h/Kconfig
```kconfig
#
# Exynos multimedia device drivers
#
config VIDEO_EXYNOS
	bool "Exynos Multimedia Devices"
	depends on ARCH_EXYNOS4 || ARCH_EXYNOS5
	default n
	select VIDEO_FIXED_MINOR_RANGES
	help
	  This is a representative exynos multimedia device.

if VIDEO_EXYNOS
	source "drivers/media/video/exynos-h/mdev/Kconfig"
	source "drivers/media/video/exynos-h/fimc-lite/Kconfig"
	source "drivers/media/video/exynos-h/mipi-csis/Kconfig"
	source "drivers/media/video/exynos-h/tv/Kconfig"
	source "drivers/media/video/exynos-h/rotator/Kconfig"
if ARCH_EXYNOS4
	source "drivers/media/video/exynos-h/fimc-is/Kconfig"
endif
if ARCH_EXYNOS5
	source "drivers/media/video/exynos-h/gsc/Kconfig"
	source "drivers/media/video/exynos-h/fimc-is-mc/Kconfig"
endif
config VIDEO_EXYNOS_MEMSIZE_FIMC_IS
	int "Memory size in Kbytes for FIMC-IS"
	depends on VIDEO_EXYNOS && (VIDEO_EXYNOS_FIMC_IS || VIDEO_EXYNOS5_FIMC_IS)
	default "10240"
	help
	  This is to assign memory used in FIMC-IS.
config VIDEO_EXYNOS_MEMSIZE_FIMC_IS_ISP
	int "Memory size in kbytes for FIMC-IS ISP(bayer)"
	depends on VIDEO_EXYNOS_FIMC_IS_BAYER
	default "61000"
	help
	  This is to assign memory used in FIMC-IS ISP.
endif

config MEDIA_EXYNOS
	bool
	help
	  Compile mdev to use exynos5 media device driver.
```

## drivers/media/video/samsung/media_monitor/Kconfig
```kconfig
config EXYNOS_MEDIA_MONITOR
	bool "MEDIA MONITOR"
	depends on VIDEO_SAMSUNG
	default n
	help
	  This is for Voodoo sound and MDNIE.
```

## drivers/misc/es305/Kconfig
```kconfig
#
# ANC es305 device
#


config ANC_ES305
	bool "ANC es305 device"
	default no
	help
		ANC es305 device cowork with WM8994
```

## drivers/smm6260_phone/Kconfig
```kconfig
#
#
#

menuconfig SMM6260_PHONE
	tristate "Smm6260 Phone Interface"
	default n
	---help---
		smm6260 phone interface.
if SMM6260_PHONE

config SMM6260_MODEM
	tristate "SMM6260 Modem support"
	help
	  Say Y here to enable SMM6260 modem control support.

config MODEM_BOOT_IN_UBOOT
	tristate "modem is booted in uboot"
	help
	  Say Y here to enable uboot power up modem.
	  
endif # SMM6260_PHONE
```

## init/Kconfig.optimise
```kconfig
menu "Kernel Optimization Options"

config CC_OPTIMIZE_FOR_SIZE
	bool "CC_OPTIMIZE_FOR_SIZE"
	default y

config CC_OPTIMIZE_DEFAULT
	bool "CC_OPTIMIZE_DEFAULT"
	default n

config CC_OPTIMIZE_MORE
	bool "CC_OPTIMIZE_MORE"
	default y

config FSYNC_OFF
    bool "Disable filesystem FSync() function"
    help
      Disable the FSync() file system command.  This will improve IO performance
      at the cost of a small risk to data integrity

endmenu
```
